## boards/shields/splaveferris/Kconfig.shield
```kconfig
# Copyright (c) 2020 The ZMK Contributors
# SPDX-License-Identifier: MIT

config SHIELD_SPLAVEFERRIS_LEFT
    def_bool $(shields_list_contains,splaveferris_left)

config SHIELD_SPLAVEFERRIS_RIGHT
    def_bool $(shields_list_contains,splaveferris_right)
```
